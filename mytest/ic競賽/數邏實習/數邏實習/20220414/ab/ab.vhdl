-- generated by Digital. Don't modify this file!
-- Any changes will be lost if this file is regenerated.

LIBRARY ieee;
USE ieee.std_logic_1164.all;
USE ieee.numeric_std.all;

entity abl is
port (A, B, CLK: in std_logic;
      Q, QN: out std_logic);	
end abl;
architecture abl1 of abl is
signal Qint: std_logic; -- internal value of Q

begin
	Q <= Qint;	-- output Q and QN to port
	QN <= not Qint;	
	process (CLK)	
	begin
		if CLK'event and CLK = '0' then  	-- falling edge of CLK
			Qint <= (A and not Qint) or (B and Qint);   
		end if;
	 end process;
end abl1;


LIBRARY ieee;
USE ieee.std_logic_1164.all;
USE ieee.numeric_std.all;

entity main is
  port (
    A: in std_logic;
    B: in std_logic;
    clk: in std_logic;
    Q: out std_logic;
    NQ: out std_logic);
end main;

architecture Behavioral of main is
begin
  gate0: entity work.abl -- abl
    port map (
      A => A,
      B => B,
      CLK => clk,
      Q => Q,
      QN => NQ);
end Behavioral;

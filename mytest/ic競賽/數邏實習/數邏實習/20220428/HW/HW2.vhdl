-- generated by Digital. Don't modify this file!
-- Any changes will be lost if this file is regenerated.

library ieee;
use ieee.std_logic_1164.all;
entity test is	
	port	(
		-- Input ports
		clk	: in  std_logic;
		
		-- Output ports		
		a_out, b_out, c_out	: out std_logic	);
end test;

architecture state_graph of test is	
	signal z : std_logic_vector(2 downto 0) := "000";
Begin
	a_out <= z(0);
	b_out <= z(1);
	c_out <= z(2);
	process(clk) is
 	begin
 		if(rising_edge(clk)) then
			if(z = "000") then z <= "111";
			elsif(z = "001") then z <= "110";
			elsif(z = "010") then z <= "000";
			elsif(z = "100") then z <= "010";
			elsif(z = "101") then z <= "100";
			elsif(z = "110") then z <= "101";
			elsif(z = "111") then z <= "001";
                        else z <= "000";
 			end if;
		end if;
	end process; 
end state_graph;


LIBRARY ieee;
USE ieee.std_logic_1164.all;
USE ieee.numeric_std.all;

entity HW2 is
  port (
    clk: in std_logic;
    a: out std_logic;
    b: out std_logic;
    c: out std_logic);
end HW2;

architecture Behavioral of HW2 is
begin
  gate0: entity work.test -- test
    port map (
      clk => clk,
      a_out => a,
      b_out => b,
      c_out => c);
end Behavioral;
